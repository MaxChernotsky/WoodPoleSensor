/**
 * @cliArgs --board "/ti/boards/CC26X2R1_LAUNCHXL" --product "simplelink_cc13x2_26x2_sdk@4.20.01.04"
 * @versions {"data":"2020021217","timestamp":"2020021217","tool":"1.4.0+1234","templates":"2020021217"}
 */

/**
 * Import the modules used in this configuration.
 */
const ble   = scripting.addModule("/ti/ble5stack/ble");
const GPIO  = scripting.addModule("/ti/drivers/GPIO");
const GPIO1 = GPIO.addInstance();
const RTOS  = scripting.addModule("/ti/drivers/RTOS");

/**
 * Write custom configuration values to the imported modules.
 */
ble.deviceRole                         = "CENTRAL_CFG+BROADCASTER_CFG";
ble.deviceName                         = "Utility Pole Sensor";
ble.radioConfig.codeExportConfig.$name = "ti_devices_radioconfig_code_export_param0";
ble.advSet1.$name                      = "ti_ble5stack_broadcaster_advertisement_set0";
ble.advSet1.advParam1.$name            = "ti_ble5stack_broadcaster_advertisement_params0";
ble.advSet1.advData1.$name             = "ti_ble5stack_broadcaster_advertisement_data0";
ble.advSet1.scanRes1.$name             = "ti_ble5stack_broadcaster_advertisement_data1";
ble.advSet2.$name                      = "ti_ble5stack_broadcaster_advertisement_set1";
ble.advSet2.advParam2.$name            = "ti_ble5stack_broadcaster_advertisement_params1";
ble.advSet2.advData2.$name             = "ti_ble5stack_broadcaster_advertisement_data2";
ble.advSet2.scanRes2.$name             = "ti_ble5stack_broadcaster_advertisement_data3";
ble.connUpdateParamsCentral.$name      = "ti_ble5stack_general_ble_conn_update_params0";

GPIO1.$hardware         = system.deviceData.board.components.LED_RED;
GPIO1.$name             = "CONFIG_GPIO_LED_0";
GPIO1.pinInstance.$name = "CONFIG_PIN_0";

const CCFG              = scripting.addModule("/ti/devices/CCFG", {}, false);
CCFG.ccfgTemplate.$name = "ti_devices_CCFGTemplate0";

/**
 * Pinmux solution for unlocked pins/peripherals. This ensures that minor changes to the automatic solver in a future
 * version of the tool will not impact the pinmux you originally saw.  These lines can be completely deleted in order to
 * re-solve from scratch.
 */
GPIO1.gpioPin.$suggestSolution = "11";
